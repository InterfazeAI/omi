## omi/firmware/devkit/Kconfig
```kconfig
source "Kconfig.zephyr"

menu "Omi Features Configuration"

config OMI_CODEC_OPUS
    bool "Opus Audio Codec"
    help
        "Enable the Opus audio codec support."
    default n

config OMI_ENABLE_OFFLINE_STORAGE
	bool "Offline SD Card Storage"
    select DISK_ACCESS
    select FILE_SYSTEM
    select FAT_FILESYSTEM_ELM
    select FS_FATFS_MOUNT_MKFS
    select FS_FATFS_EXFAT
    help
        "Enable the offline storage support. Requires a SD Card."
	default n

config OMI_RING_SEGMENT_COUNT
    int "Recording segments to keep before overwriting the oldest"
    default 128
    range 2 200
    help
        "How many segment files the recording ring holds. Eviction drops a whole segment, so
        this sets how coarse the loss is: at 128 you lose under 1% of retained audio at a
        time. Capped at 200 because the segment number is a byte on the wire."

config OMI_RING_SEGMENT_BYTES
    int "Fixed segment size in bytes (0 = derive from free space)"
    default 0
    help
        "Leave at 0 in production: the segment size is then derived from the card's free
        space at mount, so the same image suits a 4 GB and a 64 GB card. Set it to force a
        size, which is how rotation and eviction get exercised in minutes rather than days.
        Rounded down to a multiple of 450560 (lcm of the write batch and the 440-byte block)."

config OMI_ENABLE_ACCELEROMETER
    bool "Accelerometer Support"
    help
        "Enable the accelerometer support."
    default n

config OMI_ENABLE_BUTTON
    bool "Button support"
    help
        "Enable the software button support."
    default n

config OMI_ENABLE_SPEAKER
    bool "Enable the speaker"
    help
        "Enable the speaker support."
    default n

config OMI_ENABLE_BATTERY
    bool "Enable the battery"
    help
        "Enable the battery support."
    default n

config OMI_ENABLE_USB
    bool "Enable the usb"
    help
        "Enable the USB power check support."
    default n

config OMI_ENABLE_HAPTIC
    bool "Enable the haptic"
    help
        "Enable the haptic support."
    default n

config OMI_ERASE_BONDS_ON_BOOT
    bool "Erase all Bluetooth bonds at startup"
    depends on BT_SETTINGS
    help
        "Recovery build, never production. There is one bond slot and no eviction, so the first
        device to pair owns the board and no other can. Bonds live in the `storage` flash
        partition, outside the app region, so a normal reflash does not clear them and there is
        no button to hold. Flash this image once, let it boot, then flash the normal image back
        and pair the device you actually want."
    default n

endmenu
```
